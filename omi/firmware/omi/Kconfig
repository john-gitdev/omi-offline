## omi/firmware/omi/Kconfig
```kconfig
source "Kconfig.zephyr"

menu "Omi Features Configuration"

config OMI_CODEC_OPUS
    bool "Opus Audio Codec"
    help
        "Enable the Opus audio codec support."
    default n

config OMI_ENABLE_OFFLINE_STORAGE
	bool "Offline SD Card Storage"
    help
        "Enable the offline storage support. Requires a SD Card."
	default n

config OMI_ENABLE_ACCELEROMETER
    bool "Accelerometer Support"
    help
        "Enable the accelerometer support."
    default n

config OMI_ENABLE_BUTTON
    bool "Button support"
    help
        "Enable the software button support."
    default n

config OMI_ENABLE_SPEAKER
    bool "Enable the speaker"
    help
        "Enable the speaker support."
    default n

config OMI_ENABLE_BATTERY
    bool "Enable the battery"
    help
        "Enable the battery support."
    default n

config OMI_ENABLE_USB
    bool "Enable the usb"
    help
        "Enable the USB power check support."
    default n

config OMI_ENABLE_HAPTIC
    bool "Enable the haptic"
    help
        "Enable the haptic support."
    default n

config OMI_ENABLE_RFSW_CTRL
    bool "Enable RFSwitch Control"
    help
        "Enable RFSwitch Control support."
    default y

config OMI_ENABLE_MONITOR
    bool "Enable monitoring/metrics system"
    help
        "Enable the monitoring system for debugging and metrics collection.
         Disable in production to save power, RAM, and flash space."
    default n

config OMI_WATCHDOG_TIMEOUT_MS
    int "Watchdog timeout (ms)"
    range 5000 300000
    default 30000
    help
        "Watchdog reset timeout in milliseconds."

config OMI_ENABLE_VAD_GATE
    bool "Enable VAD Gate"
    help
        "Enable the VAD gate support."
    default n

config OMI_VAD_ABS_THRESHOLD
    int "VAD Absolute Threshold"
    help
        "Absolute amplitude threshold for voice detection."
    default 600

config OMI_VAD_DEBOUNCE_FRAMES
    int "VAD Debounce Frames"
    help
        "Number of consecutive frames with voice before recording starts."
    default 3

config OMI_VAD_HOLD_MS
    int "VAD Hold Time (ms)"
    help
        "Time to keep recording after voice stops."
    default 3000

config OMI_ENABLE_T5838_AAD
    bool "T5838 Hardware AAD"
    depends on OMI_ENABLE_VAD_GATE
    help
        "Enable T5838 hardware acoustic activity detection support."
    default n

endmenu
```
